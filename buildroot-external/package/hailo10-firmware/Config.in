## buildroot-external/package/hailo10-firmware/Config.in
```kconfig
config BR2_PACKAGE_HAILO10_FIRMWARE
	bool "Hailo-10 Firmware"
	help
	  Firmware for Hailo-10H PCIe device. Required for hailo1x_pci
	  kernel module.
```

## buildroot-external/package/hailo10-pci/Config.in
```kconfig
config BR2_PACKAGE_HAILO10_PCI
	bool "Hailo-10 PCIe Driver"
	depends on BR2_LINUX_KERNEL
	help
	  Kernel driver for interacting with Hailo-10 devices over PCIe.
	  Builds the hailo1x_pci module from hailort-drivers.
```

## buildroot-external/package/hailo8-pci/Config.in
```kconfig
config BR2_PACKAGE_HAILO8_PCI
	bool "Hailo-8 PCIe Driver"
	depends on BR2_LINUX_KERNEL
	help
	  Kernel driver for interacting with Hailo-8 devices over PCIe.
	  Used e.g. for Hailo-8(L) PCIe device found e.g. on Raspberry
	  Pi AI Kit and Raspberry Pi AI HAT+.
```
